## config/boards/arm/keys60/Kconfig.board
```kconfig
# Keys60 board configuration

# Copyright (c) 2021 Polarity Works
# SPDX-License-Identifier: MIT

config BOARD_KEYS60_V0P5
	bool "keys60 v0p5"
	depends on SOC_NRF52840_QIAA
```

## config/boards/arm/keys60/Kconfig.defconfig
```kconfig
# Copyright (c) 2024 sig (Signiq)
# SPDX-License-Identifier: MIT

if BOARD_KEYS60_V0P5

config BOARD
	default "keys60"

if USB

config USB_NRFX
	default y

config USB_DEVICE_STACK
	default y

endif # USB

config BT_CTLR
	default BT

config ZMK_BLE
	default y

config ZMK_USB
	default y

config ZMK_BATTERY_VOLTAGE_DIVIDER
	default y

config ZMK_KEYBOARD_NAME
	default "Keys60"

endif # BOARD_KEYS60_V0P5
```

## boards/sig/keys60/Kconfig.defconfig
```kconfig
# Copyright (c) 2024 sig (Toxsig)
# SPDX-License-Identifier: MIT

if BOARD_KEYS60

config BOARD
	default "keys60"

config ZMK_KEYBOARD_NAME
	default "Keys60"

if USB

config USB_NRFX
	default y

config USB_DEVICE_STACK
	default y

config USB_DEVICE_MANUFACTURER
        default "sig"

endif # USB

if BT

config BT_DIS_MANUF
        default "sig"

config BT_DIS_MODEL
        default "Keys60"

endif # BT

config BT_CTLR
	default BT

config ZMK_BLE
	default y

config ZMK_USB
	default y

config ZMK_BATTERY_VOLTAGE_DIVIDER
	default y

endif # BOARD_KEYS60
```

## boards/sig/keys60/Kconfig.keys60
```kconfig
# Keys60 board configuration

# Copyright (c) 2026 sig (Toxsig)
# SPDX-License-Identifier: MIT

config BOARD_KEYS60
    select SOC_NRF52840_QIAA
    imply RETAINED_MEM
    imply RETENTION
    imply RETENTION_BOOT_MODE

config KEYS60_OLED_RAW_TEST
    bool "Enable direct SSD1306 raw-pattern test"
    default n
```

## config/boards/sig/keys60/Kconfig.keys60
```kconfig
# Keys60 board configuration

# Copyright (c) 2026 sig (Toxsig)
# SPDX-License-Identifier: MIT

config BOARD_KEYS60
    select SOC_NRF52840_QIAA
    imply RETAINED_MEM
    imply RETENTION
    imply RETENTION_BOOT_MODE
```

## config/boards/sig/keys60/board.yml
```yaml
board:
  name: keys60
  vendor: sig
  socs:
    - name: nrf52840
  revision:
    format: custom
    default: rev_ansi62_rot
    revisions:
      - name: rev_ansi62_rot
      - name: rev_ansi61
      - name: rev_ansi61_rot
      - name: rev_ansi64
```
